VERSION ""
BO_ 1 M: 8 A
 SG_ S : 60|8@1+ (1,0) [0|0] "" A
