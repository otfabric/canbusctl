VERSION ""
BU_: A
BO_ 1 Wide64: 8 A
 SG_ U64 : 0|64@1+ (1,0) [0|0] "" A
BO_ 2 Pedal: 2 A
 SG_ Throttle : 0|8@1+ (0.1,0) [0|25.5] "%" A
